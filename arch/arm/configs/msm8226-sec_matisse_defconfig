## arch/arm/configs/msm8226-sec_matisse_defconfig
```kconfig
#variant defconfig
CONFIG_MACH_MATISSEWIFI_OPEN=y
CONFIG_SEC_MATISSE_PROJECT=y
CONFIG_SEC_MATISSEWIFI_COMMON=y
CONFIG_SEC_MATISSELTE_COMMON=y
CONFIG_MACH_MATISSELTE_OPEN=y
```

## arch/arm/configs/msm8226-sec_matissewifi_defconfig
```kconfig
#variant defconfig
CONFIG_MACH_MATISSEWIFI_OPEN=y
CONFIG_SEC_MATISSE_PROJECT=y
CONFIG_SEC_MATISSEWIFI_COMMON=y

CONFIG_KERNEL_XZ=y

CONFIG_IKCONFIG=y
CONFIG_IKCONFIG_PROC=y
CONFIG_ATAGS_PROC=n
CONFIG_PROC_DEVICETREE=y
CONFIG_LOG_BUF_SHIFT=21

CONFIG_KEXEC=y
CONFIG_KEXEC_HARDBOOT=y
```
